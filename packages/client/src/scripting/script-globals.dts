// AUTO-GENERATED by packages/client/scripts/gen-script-globals.ts.
// Do not edit by hand. Source of truth: script-globals-types.ts.

interface ReadOnlyComponentView {
    readonly state: Readonly<Record<string, unknown>>;
}

type Listener = (payload: unknown) => void;

type SeatIndex = number;

type AssetType = 'image' | 'model' | 'sound' | 'spritesheet';

interface AssetEntry {
    readonly slug: string;
    readonly name: string;
    readonly type: AssetType;
    readonly url: string;
    readonly preload: boolean;
    readonly description?: string;
    readonly tags?: readonly string[];
    readonly cols?: number;
    readonly rows?: number;
    readonly bundled?: boolean;
    readonly hash?: string;
}

declare class AssetsApi {
  get(slug: string): AssetEntry | null;
  list(opts?: { type?: AssetType }): ReadonlyArray<AssetEntry>;
}

type ShapeKind = 'rect' | 'circle';

type ImageFit = 'fit' | 'cover' | 'stretch' | 'none';

interface ShapeOpts {
    shape?: ShapeKind;
    fill?: string;
    stroke?: string;
    strokeWidth?: number;
    radius?: number;
}

type ButtonImageSlot = 'normal' | 'hovered' | 'pressed';

interface ButtonImagesPatch {
    normal?: string;
    hovered?: string;
    pressed?: string;
}

type StickerFace = 'top' | 'bottom' | 'front' | 'back' | 'left' | 'right';

interface StickerOpts {
    face: StickerFace;
    size?: [
        number,
        number
    ];
    offset?: number;
    canvasSize?: [
        number,
        number
    ];
    content: {
        shape: {
            kind: ShapeKind;
            fill?: string;
            stroke?: string;
            strokeWidth?: number;
            radius?: number;
        };
    } | {
        image: string;
        fit?: ImageFit;
    } | {
        html: string;
    } | {
        button: {
            normal: string;
            hovered?: string;
            pressed?: string;
            fit?: ImageFit;
        };
    };
}

type EntityEvent = 'pressed' | 'released' | 'click' | 'hover-start' | 'hover-move' | 'hover-end' | 'value-changed';

declare class EntityFacade {
  readonly id: string;
  readonly type: string;
  readonly name: string;
  readonly owner: SeatIndex | null;
  readonly tags: string[];
  getComponent(typeId: string): ReadOnlyComponentView | undefined;
  addEventListener(event: EntityEvent, cb: Listener): void;
  removeEventListener(event: EntityEvent, cb: Listener): void;
  setValue(value: string): void;
  setData(key: string, value: string): void;
  getData(key: string): string | undefined;
  deleteData(key: string): boolean;
}

type ElementEvent = 'pressed' | 'released' | 'click' | 'hover-start' | 'hover-end';

declare class ElementHandle {
  readonly surfaceId: string;
  readonly elementId: string;
  setBounds(x: number, y: number, w: number, h: number): void;
  setHtml(html: string): void;
  setImageRef(ref: string): void;
  setImageFit(fit: ImageFit): void;
  setShape(opts: ShapeOpts): void;
  setButtonImages(images: ButtonImagesPatch): void;
  setButtonImage(slot: ButtonImageSlot, ref: string): void;
  setButtonFit(fit: ImageFit): void;
  addEventListener(event: ElementEvent, cb: Listener): void;
  removeEventListener(event: ElementEvent, cb: Listener): void;
}

type EndedBy = 'player' | 'host' | 'script';

declare class TurnsApi {
  enable(order?: SeatIndex[]): void;
  disable(): void;
  next(): void;
  setActive(seat: SeatIndex): void;
  setOrder(order: SeatIndex[]): void;
  isEnabled(): boolean;
  getActive(): SeatIndex | null;
  getOrder(): SeatIndex[];
  getTurnNumber(): number;
}

declare class SceneFacade {
  readonly assets: AssetsApi;
  readonly turns: TurnsApi;
  getObjectById(id: string): EntityFacade | undefined;
  getTable(): EntityFacade | undefined;
  getObjectsByTag(tag: string): EntityFacade[];
  playSound(slug: string): void;
  attachSticker(parent: EntityFacade, opts: StickerOpts): ElementHandle | null;
  getElement(surfaceId: string, elementId: string): ElementHandle | null;
}

declare class Game {
  scene: unknown;
  onSceneInitialised(scene: SceneFacade): void;
  onScriptLoaded(scene: SceneFacade): void;
  onTurnStart(seat: SeatIndex, turnNumber: number): void;
  onTurnEnd(seat: SeatIndex, turnNumber: number, endedBy: EndedBy): void;
  onTurnEndRequested(seat: SeatIndex): void;
}

declare global {
  var scene: SceneFacade;
  var Game: typeof Game;
  var game: Game | null;
  var console: Pick<Console, 'log' | 'error' | 'warn' | 'info' | 'debug'>;
}
